## boards/arm/tle9879_ek/Kconfig.board
```kconfig
# Copyright (c) 2021 Nordic Semiconductor ASA
# SPDX-License-Identifier: Apache-2.0

config BOARD_TLE9879_EK
	bool "Infineon TLE9879 Evaluation Kit"
	depends on SOC_NRF52840_QIAA
```

## boards/arm/tle9879_ek/Kconfig.defconfig
```kconfig
# Copyright (c) 2021 Nordic Semiconductor ASA
# SPDX-License-Identifier: Apache-2.0

if BOARD_TLE9879_EK

config BOARD
	default "tle9879_ek"

endif # BOARD_TLE9879_EK
```

## boards/arm/tle9879_ek/tle9879_ek_defconfig
```kconfig
# Copyright (c) 2021 Nordic Semiconductor ASA
# SPDX-License-Identifier: Apache-2.0

CONFIG_SOC_SERIES_NRF52X=y
CONFIG_SOC_NRF52840_QIAA=y
CONFIG_BOARD_TLE9879_EK=y

CONFIG_ARM_MPU=y
CONFIG_HW_STACK_PROTECTION=y
```

## soc/arm/tle987x/Kconfig.defconfig.series
```kconfig
if SOC_SERIES_TLE9879X

rsource "./Kconfig.defconfig.tle987*"

config SOC_SERIES
	default "tle987x"

config SRAM_VECTOR_TABLE
	default y

endif # SOC_SERIES_STM32F0X
```

## soc/arm/tle987x/Kconfig.series
```kconfig
config SOC_SERIES_TLE9879X
	bool "Infineon TLE9879x Series MCU"
	select ARM
	select CPU_CORTEX_M3
	select CPU_CORTEX_M_HAS_SYSTICK
    select SOC_FAMILY_TLE9879X
```

## soc/arm/tle987x/tle9879x/Kconfig.defconfig.series
```kconfig
# Nordic Semiconductor nRF51 MCU line

# Copyright (c) 2016 Linaro Limited
# Copyright (c) 2018 Nordic Semiconductor ASA
# SPDX-License-Identifier: Apache-2.0

if SOC_SERIES_TLE987X

rsource "./Kconfig.defconfig.tle987*"

config SOC_SERIES
	default "tle987x"

config NUM_IRQS
	default 26

endif # SOC_SERIES_NRF51X
```

## soc/arm/tle987x/tle9879x/Kconfig.defconfig.tle9879qxw40
```kconfig
# Copyright (c) 2019 Antony Pavlov <antonynpavlov@gmail.com>
# SPDX-License-Identifier: Apache-2.0

config SOC
	default "tle9879qxa40"
	depends on SOC_TLE9879QXW40
```

## soc/arm/tle987x/tle9879x/Kconfig.series
```kconfig
# Nordic Semiconductor nRF51 MCU line

# Copyright (c) 2016 Linaro Limited
# Copyright (c) 2018 Nordic Semiconductor ASA
# SPDX-License-Identifier: Apache-2.0

config SOC_SERIES_TLE987X
	bool "Infineon TLE987x Series MCU"
	select ARM
	select CPU_CORTEX_M0
	select SOC_FAMILY_TLE987X
	select HAS_SEGGER_RTT
	help
	  Enable support for NRF51 MCU series
```

## soc/arm/tle987x/tle9879x/Kconfig.soc
```kconfig
# Nordic Semiconductor nRF51 MCU line

# Copyright (c) 2016 Linaro Limited
# SPDX-License-Identifier: Apache-2.0

choice
	prompt "nRF51x MCU Selection"
	depends on SOC_SERIES_TLE987X

config SOC_TLE9879QXA40
	bool "TLE9879QXA40"
	select HAS_HW_NRF_ADC

config SOC_TLE9879QXW40
	bool "TLE9879QXW40"
	select HAS_HW_NRF_ADC
	select HAS_HW_NRF_CCM

endchoice
```

## west.yml
```yaml
# Copyright (c) 2021 Nordic Semiconductor ASA
# SPDX-License-Identifier: Apache-2.0

manifest:
  self:
    path: bldc_foc

  remotes:
    - name: zephyrproject-rtos-fork
      url-base: https://github.com/ASethi77

  projects:
    - name: zephyr
      remote: zephyrproject-rtos-fork
      revision: infineon_tle9879_ek_soc
      import: true
```
